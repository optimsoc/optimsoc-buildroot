## configs/optimsoc_computetile_singlecore_defconfig
```kconfig
BR2_or1k=y
BR2_TOOLCHAIN_BUILDROOT_MUSL=y
BR2_TOOLCHAIN_BUILDROOT_CXX=y
BR2_TARGET_GENERIC_HOSTNAME="optimsoc"
BR2_TARGET_GENERIC_ISSUE="Welcome to OpTiMSoC"
BR2_LINUX_KERNEL=y
BR2_LINUX_KERNEL_PATCH="$(BR2_EXTERNAL_OPTIMSOC_PATH)/patches/linux $(BR2_EXTERNAL_OPTIMSOC_PATH)/board/compute_tile_singlecore/patches/linux"
BR2_LINUX_KERNEL_USE_CUSTOM_CONFIG=y
BR2_LINUX_KERNEL_CUSTOM_CONFIG_FILE="$(BR2_EXTERNAL_OPTIMSOC_PATH)/board/compute_tile_singlecore/kernel.config"
BR2_PACKAGE_DHRYSTONE=y
BR2_PACKAGE_WHETSTONE=y
BR2_PACKAGE_SL=y
BR2_TARGET_ROOTFS_CPIO_GZIP=y
BR2_TARGET_ROOTFS_INITRAMFS=y
# BR2_TARGET_ROOTFS_TAR is not set
BR2_PACKAGE_PACMAN4CONSOLE=y
```

## package/pacman4console/Config.in
```kconfig
config BR2_PACKAGE_PACMAN4CONSOLE
    bool "pacman4console"
    select BR2_PACKAGE_NCURSES
    help
        Console version of the game classic Pacman.

        https://sites.google.com/site/doctormike/pacman.html
```
